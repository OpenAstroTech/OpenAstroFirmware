## CMakeLists.txt
```
# Copyright (c) 2025, OpenAstroTech
# SPDX-License-Identifier: Apache-2.0

cmake_minimum_required(VERSION 3.20.0)
find_package(Zephyr REQUIRED HINTS $ENV{ZEPHYR_BASE})
project(lx200_lib_test)

# Set C++20 standard
set(CMAKE_CXX_STANDARD 20)
set(CMAKE_CXX_STANDARD_REQUIRED ON)
set(CMAKE_CXX_EXTENSIONS OFF)

# C++20 test sources
target_sources(app PRIVATE 
    src/main.cpp
    src/test_parser.cpp
    src/test_coordinates.cpp
    src/test_commands.cpp
    src/test_integration.cpp
)

# Compiler flags for embedded C++20
target_compile_options(app PRIVATE
  -fno-exceptions
  -fno-rtti
  -fno-threadsafe-statics
)
```

## prj.conf
```kconfig
CONFIG_ZTEST=y
CONFIG_LX200=y

# C++ support - enable full C++20 standard library
CONFIG_CPP=y
CONFIG_STD_CPP20=y
CONFIG_REQUIRES_FULL_LIBCPP=y

# Enable logging for test debugging
CONFIG_LOG=y
CONFIG_LOG_DEFAULT_LEVEL=3
CONFIG_LX200_LOG_LEVEL_DBG=y

# Enable assertions
CONFIG_ASSERT=y

# Increase main stack size for complex tests
CONFIG_MAIN_STACK_SIZE=2048
```

## src/main.c
```c
/**
 * @file main.c
 * @brief LX200 Library Test Suite
 *
 * Copyright (c) 2025, OpenAstroTech
 * SPDX-License-Identifier: Apache-2.0
 */

#include <string.h>
#include <zephyr/ztest.h>
#include <lx200/lx200.h>

/* Test helper macros */
#define ASSERT_PARSE_OK(result) zassert_equal(result, LX200_PARSE_OK, "Parse should succeed")
#define ASSERT_PARSE_ERROR(result, expected) zassert_equal(result, expected, "Expected specific parse error")

/* Test fixtures */
static lx200_parser_state_t parser_state;
static lx200_command_t command;

/**
 * @brief Setup function called before each test
 */
static void lx200_test_setup(void *fixture)
{
	ARG_UNUSED(fixture);
	lx200_parser_init(&parser_state);
	memset(&command, 0, sizeof(command));
}

/**
 * @brief Teardown function called after each test
 */
static void lx200_test_teardown(void *fixture)
{
	ARG_UNUSED(fixture);
	lx200_parser_reset(&parser_state);
}

/* ============================================================================
 * PARSER INITIALIZATION AND STATE TESTS
 * ============================================================================ */

ZTEST(lx200_parser, test_parser_init_valid)
{
	lx200_parser_state_t state;
	
	lx200_parser_init(&state);
	
	zassert_equal(state.buffer_length, 0, "Buffer length should be 0");
	zassert_false(state.command_complete, "Command should not be complete");
	zassert_equal(state.precision_mode, LX200_COORD_HIGH_PRECISION, 
		      "Should default to high precision");
	zassert_equal(state.buffer[0], '\0', "Buffer should be null-terminated");
}

ZTEST(lx200_parser, test_parser_init_null)
{
	/* Should not crash with NULL pointer */
	lx200_parser_init(NULL);
	zassert_true(true, "Should handle NULL gracefully");
}

ZTEST(lx200_parser, test_parser_reset)
{
	/* Setup some state first */
	strcpy(parser_state.buffer, ":Gr");
	parser_state.buffer_length = 3;
	parser_state.command_complete = true;
	
	lx200_parser_reset(&parser_state);
	
	zassert_equal(parser_state.buffer_length, 0, "Buffer length should be 0");
	zassert_false(parser_state.command_complete, "Command should not be complete");
	zassert_equal(parser_state.buffer[0], '\0', "Buffer should be null-terminated");
}

ZTEST(lx200_parser, test_precision_mode_functions)
{
	/* Test getting current precision */
	lx200_precision_t precision = lx200_get_precision_mode(&parser_state);
	zassert_equal(precision, LX200_COORD_HIGH_PRECISION, "Should be high precision");
	
	/* Test setting precision */
	lx200_set_precision_mode(&parser_state, LX200_COORD_LOW_PRECISION);
	precision = lx200_get_precision_mode(&parser_state);
	zassert_equal(precision, LX200_COORD_LOW_PRECISION, "Should be low precision");
	
	/* Test NULL handling */
	precision = lx200_get_precision_mode(NULL);
	zassert_equal(precision, LX200_COORD_HIGH_PRECISION, "Should default to high precision");
	
	lx200_set_precision_mode(NULL, LX200_COORD_LOW_PRECISION);
	/* Should not crash */
	zassert_true(true, "Should handle NULL gracefully");
}

/* ============================================================================
 * COMMAND PARSING TESTS
 * ============================================================================ */

ZTEST(lx200_parser, test_add_data_valid_complete_command)
{
	const char *cmd = ":Gr#";
	lx200_parse_result_t result;
	
	result = lx200_parser_add_data(&parser_state, cmd, strlen(cmd));
	
	ASSERT_PARSE_OK(result);
	zassert_true(parser_state.command_complete, "Command should be complete");
	zassert_equal(parser_state.buffer_length, strlen(cmd), "Buffer length should match");
	zassert_mem_equal(parser_state.buffer, cmd, strlen(cmd), "Buffer should contain command");
}

ZTEST(lx200_parser, test_add_data_incomplete_command)
{
	const char *cmd = ":Gr";
	lx200_parse_result_t result;
	
	result = lx200_parser_add_data(&parser_state, cmd, strlen(cmd));
	
	ASSERT_PARSE_ERROR(result, LX200_PARSE_INCOMPLETE);
	zassert_false(parser_state.command_complete, "Command should not be complete");
	zassert_equal(parser_state.buffer_length, strlen(cmd), "Buffer length should match");
}

ZTEST(lx200_parser, test_add_data_incremental)
{
	lx200_parse_result_t result;
	
	/* Add data incrementally */
	result = lx200_parser_add_data(&parser_state, ":", 1);
	ASSERT_PARSE_ERROR(result, LX200_PARSE_INCOMPLETE);
	
	result = lx200_parser_add_data(&parser_state, "G", 1);
	ASSERT_PARSE_ERROR(result, LX200_PARSE_INCOMPLETE);
	
	result = lx200_parser_add_data(&parser_state, "r", 1);
	ASSERT_PARSE_ERROR(result, LX200_PARSE_INCOMPLETE);
	
	result = lx200_parser_add_data(&parser_state, "#", 1);
	ASSERT_PARSE_OK(result);
	
	zassert_true(parser_state.command_complete, "Command should be complete");
	zassert_str_equal(parser_state.buffer, ":Gr#", "Buffer should contain complete command");
}

ZTEST(lx200_parser, test_add_data_buffer_overflow)
{
	char long_data[LX200_MAX_COMMAND_LENGTH + 10];
	lx200_parse_result_t result;
	
	memset(long_data, 'X', sizeof(long_data) - 1);
	long_data[sizeof(long_data) - 1] = '\0';
	
	result = lx200_parser_add_data(&parser_state, long_data, sizeof(long_data) - 1);
	
	ASSERT_PARSE_ERROR(result, LX200_PARSE_BUFFER_OVERFLOW);
}

ZTEST(lx200_parser, test_add_data_invalid_parameters)
{
	lx200_parse_result_t result;
	
	/* NULL state */
	result = lx200_parser_add_data(NULL, ":Gr#", 4);
	ASSERT_PARSE_ERROR(result, LX200_PARSE_ERROR);
	
	/* NULL data */
	result = lx200_parser_add_data(&parser_state, NULL, 4);
	ASSERT_PARSE_ERROR(result, LX200_PARSE_ERROR);
	
	/* Zero length */
	result = lx200_parser_add_data(&parser_state, ":Gr#", 0);
	ASSERT_PARSE_ERROR(result, LX200_PARSE_ERROR);
}

ZTEST(lx200_parser, test_parse_command_string_get_ra)
{
	const char *cmd = ":Gr#";
	lx200_parse_result_t result;
	
	result = lx200_parse_command_string(cmd, &command);
	
	ASSERT_PARSE_OK(result);
	zassert_str_equal(command.command, "Gr", "Command should be 'Gr'");
	zassert_equal(command.family, LX200_CMD_GET, "Should be GET command family");
	zassert_false(command.has_parameter, "Should not have parameter");
	zassert_equal(command.parameter_length, 0, "Parameter length should be 0");
}

ZTEST(lx200_parser, test_parse_command_string_set_ra_with_parameter)
{
	const char *cmd = ":Sr14:30:45#";
	lx200_parse_result_t result;
	
	result = lx200_parse_command_string(cmd, &command);
	
	ASSERT_PARSE_OK(result);
	zassert_str_equal(command.command, "Sr", "Command should be 'Sr'");
	zassert_equal(command.family, LX200_CMD_SET, "Should be SET command family");
	zassert_true(command.has_parameter, "Should have parameter");
	zassert_str_equal(command.parameter, "14:30:45", "Parameter should be time");
	zassert_equal(command.parameter_length, 8, "Parameter length should be 8");
}

ZTEST(lx200_parser, test_parse_command_string_various_commands)
{
	struct {
		const char *cmd;
		const char *expected_command;
		lx200_command_family_t expected_family;
		bool has_param;
	} test_cases[] = {
		{":AA#", "AA", LX200_CMD_ALIGNMENT, false},
		{":B+#", "B+", LX200_CMD_RETICLE, false},
		{":CM#", "CM", LX200_CMD_SYNC, false},
		{":D#", "D", LX200_CMD_DISTANCE, false},
		{":F+#", "F+", LX200_CMD_FOCUSER, false},
		{":GD#", "GD", LX200_CMD_GET, false},
		{":gT#", "gT", LX200_CMD_GPS, false},
		{":H#", "H", LX200_CMD_TIME_FORMAT, false},
		{":I#", "I", LX200_CMD_INITIALIZE, false},
		{":LM#", "LM", LX200_CMD_LIBRARY, false},
		{":Mn#", "Mn", LX200_CMD_MOVE, false},
		{":P#", "P", LX200_CMD_PRECISION, false},
		{":Q#", "Q", LX200_CMD_STOP, false},
		{":RG#", "RG", LX200_CMD_SLEW_RATE, false},
		{":Sd+45*30:15#", "Sd", LX200_CMD_SET, true},
		{":TL#", "TL", LX200_CMD_TRACKING, false},
		{":U#", "U", LX200_CMD_PRECISION_TOGGLE, false},
	};
	
	for (size_t i = 0; i < ARRAY_SIZE(test_cases); i++) {
		memset(&command, 0, sizeof(command));
		lx200_parse_result_t result = lx200_parse_command_string(test_cases[i].cmd, &command);
		
		ASSERT_PARSE_OK(result);
		zassert_str_equal(command.command, test_cases[i].expected_command,
				  "Command mismatch for %s", test_cases[i].cmd);
		zassert_equal(command.family, test_cases[i].expected_family,
			      "Family mismatch for %s", test_cases[i].cmd);
		zassert_equal(command.has_parameter, test_cases[i].has_param,
			      "Parameter flag mismatch for %s", test_cases[i].cmd);
	}
}

ZTEST(lx200_parser, test_parse_command_string_invalid_prefix)
{
	const char *cmd = "Gr#";  /* Missing ':' prefix */
	lx200_parse_result_t result;
	
	result = lx200_parse_command_string(cmd, &command);
	
	ASSERT_PARSE_ERROR(result, LX200_PARSE_INVALID_PREFIX);
}

ZTEST(lx200_parser, test_parse_command_string_invalid_terminator)
{
	const char *cmd = ":Gr";  /* Missing '#' terminator */
	lx200_parse_result_t result;
	
	result = lx200_parse_command_string(cmd, &command);
	
	ASSERT_PARSE_ERROR(result, LX200_PARSE_INVALID_TERMINATOR);
}

ZTEST(lx200_parser, test_parse_command_string_too_short)
{
	const char *cmd = ":";  /* Too short */
	lx200_parse_result_t result;
	
	result = lx200_parse_command_string(cmd, &command);
	
	ASSERT_PARSE_ERROR(result, LX200_PARSE_INVALID_COMMAND);
}

ZTEST(lx200_parser, test_parse_command_string_null_parameters)
{
	lx200_parse_result_t result;
	
	/* NULL command string */
	result = lx200_parse_command_string(NULL, &command);
	ASSERT_PARSE_ERROR(result, LX200_PARSE_ERROR);
	
	/* NULL command structure */
	result = lx200_parse_command_string(":Gr#", NULL);
	ASSERT_PARSE_ERROR(result, LX200_PARSE_ERROR);
}

ZTEST(lx200_parser, test_parse_command_from_state)
{
	lx200_parse_result_t result;
	
	/* Add complete command to parser */
	result = lx200_parser_add_data(&parser_state, ":Gr#", 4);
	ASSERT_PARSE_OK(result);
	
	/* Parse command from state */
	result = lx200_parse_command(&parser_state, &command);
	ASSERT_PARSE_OK(result);
	
	zassert_str_equal(command.command, "Gr", "Command should be 'Gr'");
	zassert_equal(command.family, LX200_CMD_GET, "Should be GET command family");
}

ZTEST(lx200_parser, test_parse_command_incomplete_state)
{
	lx200_parse_result_t result;
	
	/* Add incomplete command to parser */
	result = lx200_parser_add_data(&parser_state, ":Gr", 3);
	ASSERT_PARSE_ERROR(result, LX200_PARSE_INCOMPLETE);
	
	/* Try to parse incomplete command */
	result = lx200_parse_command(&parser_state, &command);
	ASSERT_PARSE_ERROR(result, LX200_PARSE_INCOMPLETE);
}

/* ============================================================================
 * COMMAND FAMILY AND UTILITY TESTS
 * ============================================================================ */

ZTEST(lx200_utils, test_get_command_family)
{
	struct {
		const char *cmd;
		lx200_command_family_t expected;
	} test_cases[] = {
		{"A", LX200_CMD_ALIGNMENT},
		{"AA", LX200_CMD_ALIGNMENT},
		{"B+", LX200_CMD_RETICLE},
		{"C", LX200_CMD_SYNC},
		{"D", LX200_CMD_DISTANCE},
		{"F", LX200_CMD_FOCUSER},
		{"G", LX200_CMD_GET},
		{"Gr", LX200_CMD_GET},
		{"g", LX200_CMD_GPS},
		{"gT", LX200_CMD_GPS},
		{"H", LX200_CMD_TIME_FORMAT},
		{"I", LX200_CMD_INITIALIZE},
		{"L", LX200_CMD_LIBRARY},
		{"M", LX200_CMD_MOVE},
		{"P", LX200_CMD_PRECISION},
		{"Q", LX200_CMD_STOP},
		{"R", LX200_CMD_SLEW_RATE},
		{"S", LX200_CMD_SET},
		{"T", LX200_CMD_TRACKING},
		{"U", LX200_CMD_PRECISION_TOGGLE},
		{"X", LX200_CMD_UNKNOWN},
		{"", LX200_CMD_UNKNOWN},
	};
	
	for (size_t i = 0; i < ARRAY_SIZE(test_cases); i++) {
		lx200_command_family_t family = lx200_get_command_family(test_cases[i].cmd);
		zassert_equal(family, test_cases[i].expected,
			      "Family mismatch for command '%s'", test_cases[i].cmd);
	}
	
	/* Test NULL parameter */
	lx200_command_family_t family = lx200_get_command_family(NULL);
	zassert_equal(family, LX200_CMD_UNKNOWN, "Should return UNKNOWN for NULL");
}

ZTEST(lx200_utils, test_command_has_parameter)
{
	struct {
		const char *cmd;
		bool expected;
	} test_cases[] = {
		{"Sr", true},   /* Set commands typically have parameters */
		{"Sd", true},
		{"SC", true},
		{"Gr", false},  /* Get commands typically don't */
		{"AA", false},  /* Alignment commands don't */
		{"Q", false},   /* Stop commands don't */
		{"", false},    /* Empty command */
	};
	
	for (size_t i = 0; i < ARRAY_SIZE(test_cases); i++) {
		bool has_param = lx200_command_has_parameter(test_cases[i].cmd);
		zassert_equal(has_param, test_cases[i].expected,
			      "Parameter flag mismatch for command '%s'", test_cases[i].cmd);
	}
	
	/* Test NULL parameter */
	bool has_param = lx200_command_has_parameter(NULL);
	zassert_false(has_param, "Should return false for NULL");
}

ZTEST(lx200_utils, test_get_parameter_format)
{
	struct {
		const char *cmd;
		const char *expected;
	} test_cases[] = {
		{"Sr", "HH:MM:SS"},
		{"Sd", "sDD*MM:SS"},
		{"SL", "HH:MM:SS"},
		{"SC", "MM/DD/YY"},
		{"S", "Various"},
		{"G", "None"},
		{"", "None"},
	};
	
	for (size_t i = 0; i < ARRAY_SIZE(test_cases); i++) {
		const char *format = lx200_get_parameter_format(test_cases[i].cmd);
		zassert_str_equal(format, test_cases[i].expected,
				  "Format mismatch for command '%s'", test_cases[i].cmd);
	}
	
	/* Test NULL parameter */
	const char *format = lx200_get_parameter_format(NULL);
	zassert_str_equal(format, "None", "Should return 'None' for NULL");
}

ZTEST(lx200_utils, test_parse_result_to_string)
{
	struct {
		lx200_parse_result_t result;
		const char *expected;
	} test_cases[] = {
		{LX200_PARSE_OK, "OK"},
		{LX200_PARSE_INCOMPLETE, "Incomplete"},
		{LX200_PARSE_INVALID_PREFIX, "Invalid prefix"},
		{LX200_PARSE_INVALID_TERMINATOR, "Invalid terminator"},
		{LX200_PARSE_INVALID_COMMAND, "Invalid command"},
		{LX200_PARSE_INVALID_PARAMETER, "Invalid parameter"},
		{LX200_PARSE_BUFFER_OVERFLOW, "Buffer overflow"},
		{LX200_PARSE_ERROR, "Parse error"},
	};
	
	for (size_t i = 0; i < ARRAY_SIZE(test_cases); i++) {
		const char *str = lx200_parse_result_to_string(test_cases[i].result);
		zassert_str_equal(str, test_cases[i].expected,
				  "String mismatch for result %d", test_cases[i].result);
	}
	
	/* Test invalid result code */
	const char *str = lx200_parse_result_to_string((lx200_parse_result_t)999);
	zassert_str_equal(str, "Parse error", "Should return 'Parse error' for invalid code");
}

/* ============================================================================
 * COMPLEX COMMAND PARSING TESTS
 * ============================================================================ */

ZTEST(lx200_complex, test_long_parameter_command)
{
	const char *cmd = ":Sr12:34:56#";
	lx200_parse_result_t result;
	
	result = lx200_parse_command_string(cmd, &command);
	
	ASSERT_PARSE_OK(result);
	zassert_str_equal(command.command, "Sr", "Command should be 'Sr'");
	zassert_true(command.has_parameter, "Should have parameter");
	zassert_str_equal(command.parameter, "12:34:56", "Parameter should be time");
	zassert_equal(command.parameter_length, 8, "Parameter length should be 8");
}

ZTEST(lx200_complex, test_multiple_commands_sequential)
{
	lx200_parse_result_t result;
	
	/* First command */
	result = lx200_parser_add_data(&parser_state, ":Gr#", 4);
	ASSERT_PARSE_OK(result);
	
	result = lx200_parse_command(&parser_state, &command);
	ASSERT_PARSE_OK(result);
	zassert_str_equal(command.command, "Gr", "First command should be 'Gr'");
	
	/* Reset and parse second command */
	lx200_parser_reset(&parser_state);
	
	result = lx200_parser_add_data(&parser_state, ":Gd#", 4);
	ASSERT_PARSE_OK(result);
	
	result = lx200_parse_command(&parser_state, &command);
	ASSERT_PARSE_OK(result);
	zassert_str_equal(command.command, "Gd", "Second command should be 'Gd'");
}

ZTEST(lx200_complex, test_command_with_special_characters)
{
	const char *cmd = ":Sd+45*30:15#";
	lx200_parse_result_t result;
	
	result = lx200_parse_command_string(cmd, &command);
	
	ASSERT_PARSE_OK(result);
	zassert_str_equal(command.command, "Sd", "Command should be 'Sd'");
	zassert_true(command.has_parameter, "Should have parameter");
	zassert_str_equal(command.parameter, "+45*30:15", "Parameter should contain special chars");
}

ZTEST(lx200_complex, test_boundary_conditions)
{
	lx200_parse_result_t result;
	char buffer[LX200_MAX_COMMAND_LENGTH];
	
	/* Test maximum length command */
	memset(buffer, 0, sizeof(buffer));
	buffer[0] = ':';
	buffer[1] = 'S';
	buffer[2] = 'r';
	/* Fill with parameter data up to max length - 2 (for ':' and '#') */
	for (int i = 3; i < LX200_MAX_COMMAND_LENGTH - 1; i++) {
		buffer[i] = '0' + (i % 10);
	}
	buffer[LX200_MAX_COMMAND_LENGTH - 1] = '#';
	
	result = lx200_parse_command_string(buffer, &command);
	ASSERT_PARSE_OK(result);
	zassert_str_equal(command.command, "Sr", "Command should be parsed correctly");
	zassert_true(command.has_parameter, "Should have parameter");
}

/* ============================================================================
 * ERROR HANDLING TESTS
 * ============================================================================ */

ZTEST(lx200_errors, test_malformed_commands)
{
	struct {
		const char *cmd;
		lx200_parse_result_t expected;
	} test_cases[] = {
		{"", LX200_PARSE_INVALID_COMMAND},
		{"#", LX200_PARSE_INVALID_COMMAND},
		{":", LX200_PARSE_INVALID_COMMAND},
		{":G", LX200_PARSE_INVALID_TERMINATOR},
		{"G#", LX200_PARSE_INVALID_PREFIX},
		{":G$", LX200_PARSE_INVALID_TERMINATOR},
		{"$G#", LX200_PARSE_INVALID_PREFIX},
	};
	
	for (size_t i = 0; i < ARRAY_SIZE(test_cases); i++) {
		lx200_parse_result_t result = lx200_parse_command_string(test_cases[i].cmd, &command);
		zassert_equal(result, test_cases[i].expected,
			      "Error mismatch for command '%s'", test_cases[i].cmd);
	}
}

ZTEST(lx200_errors, test_parameter_too_long)
{
	char long_cmd[LX200_MAX_COMMAND_LENGTH * 2];
	lx200_parse_result_t result;
	
	/* Create command with parameter that's too long */
	strcpy(long_cmd, ":Sr");
	for (int i = 3; i < sizeof(long_cmd) - 2; i++) {
		long_cmd[i] = '0';
	}
	long_cmd[sizeof(long_cmd) - 2] = '#';
	long_cmd[sizeof(long_cmd) - 1] = '\0';
	
	result = lx200_parse_command_string(long_cmd, &command);
	ASSERT_PARSE_ERROR(result, LX200_PARSE_BUFFER_OVERFLOW);
}

/* ============================================================================
 * TEST SUITE DEFINITIONS
 * ============================================================================ */

ZTEST_SUITE(lx200_parser, NULL, NULL, lx200_test_setup, lx200_test_teardown, NULL);
ZTEST_SUITE(lx200_utils, NULL, NULL, NULL, NULL, NULL);
ZTEST_SUITE(lx200_complex, NULL, NULL, lx200_test_setup, lx200_test_teardown, NULL);
ZTEST_SUITE(lx200_errors, NULL, NULL, NULL, NULL, NULL);
```

## src/main.cpp
```c
/*
 * Copyright (c) 2025, OpenAstroTech
 * SPDX-License-Identifier: Apache-2.0
 */

#include <zephyr/ztest.h>

/**
 * @brief LX200 C++20 Test Suite
 *
 * This test suite validates the C++20 rewrite of the LX200 telescope
 * control protocol parser. Tests are organized by component:
 *
 * - Parser tests: Command parsing, state management
 * - Coordinate tests: RA/DEC/ALT/AZ/LAT/LON parsing
 * - Command tests: Command family identification
 * - Integration tests: End-to-end protocol validation
 */

/* Test suite declarations - defined in separate files */
extern "C" {
void test_suite_parser(void);
void test_suite_coordinates(void);
void test_suite_commands(void);
void test_suite_integration(void);
}

/**
 * @brief Main test entry point
 *
 * Zephyr test runner will execute all registered test suites.
 * Each suite is defined in its own source file for modularity.
 */
ZTEST_SUITE(lx200, NULL, NULL, NULL, NULL, NULL);
```

## src/test_coordinates.c
```c
/**
 * @file test_coordinates.c
 * @brief LX200 Coordinate Parsing Test Suite
 *
 * These tests are for the coordinate parsing functions that are currently
 * unimplemented. They serve as specifications for future implementation.
 *
 * Copyright (c) 2025, OpenAstroTech
 * SPDX-License-Identifier: Apache-2.0
 */

#include <string.h>
#include <zephyr/ztest.h>
#include <lx200/lx200.h>

/* Test fixtures */
static lx200_coordinate_t coordinate;
static lx200_time_t time_val;
static lx200_date_t date_val;

/**
 * @brief Setup function called before each test
 */
static void coordinate_test_setup(void *fixture)
{
	ARG_UNUSED(fixture);
	memset(&coordinate, 0, sizeof(coordinate));
	memset(&time_val, 0, sizeof(time_val));
	memset(&date_val, 0, sizeof(date_val));
}

/* ============================================================================
 * RIGHT ASCENSION COORDINATE PARSING TESTS
 * ============================================================================ */

ZTEST(lx200_coordinates, test_parse_ra_high_precision)
{
	/* These tests will pass once the functions are implemented */
	
	/* Test valid RA in high precision format: HH:MM:SS */
	const char *ra_str = "14:30:45";
	lx200_parse_result_t result = lx200_parse_ra_coordinate(ra_str, &coordinate);
	
	/* Currently returns error since not implemented */
	zassert_equal(result, LX200_PARSE_ERROR, "Function not implemented yet");
	
	/* TODO: When implemented, test should be:
	 * ASSERT_PARSE_OK(result);
	 * zassert_equal(coordinate.degrees, 14, "Hours should be 14");
	 * zassert_equal(coordinate.minutes, 30, "Minutes should be 30");
	 * zassert_equal(coordinate.seconds, 45, "Seconds should be 45");
	 * zassert_equal(coordinate.precision, LX200_COORD_HIGH_PRECISION, "Should be high precision");
	 */
}

ZTEST(lx200_coordinates, test_parse_ra_low_precision)
{
	/* Test valid RA in low precision format: HH:MM.T */
	const char *ra_str = "14:30.5";
	lx200_parse_result_t result = lx200_parse_ra_coordinate(ra_str, &coordinate);
	
	/* Currently returns error since not implemented */
	zassert_equal(result, LX200_PARSE_ERROR, "Function not implemented yet");
	
	/* TODO: When implemented, test should be:
	 * ASSERT_PARSE_OK(result);
	 * zassert_equal(coordinate.degrees, 14, "Hours should be 14");
	 * zassert_equal(coordinate.minutes, 30, "Minutes should be 30");
	 * zassert_equal(coordinate.tenths, 5, "Tenths should be 5");
	 * zassert_equal(coordinate.precision, LX200_COORD_LOW_PRECISION, "Should be low precision");
	 */
}

ZTEST(lx200_coordinates, test_parse_ra_boundary_values)
{
	struct {
		const char *ra_str;
		const char *description;
	} test_cases[] = {
		{"00:00:00", "Minimum RA value"},
		{"23:59:59", "Maximum RA value"},
		{"12:00:00", "Noon RA value"},
		{"06:30:15", "Mid-morning RA value"},
		{"18:45:30", "Evening RA value"},
	};
	
	for (size_t i = 0; i < ARRAY_SIZE(test_cases); i++) {
		lx200_parse_result_t result = lx200_parse_ra_coordinate(test_cases[i].ra_str, &coordinate);
		
		/* Currently all return error since not implemented */
		zassert_equal(result, LX200_PARSE_ERROR, "Function not implemented yet: %s", 
			      test_cases[i].description);
	}
}

/* ============================================================================
 * DECLINATION COORDINATE PARSING TESTS
 * ============================================================================ */

ZTEST(lx200_coordinates, test_parse_dec_positive)
{
	/* Test positive declination: +DD*MM:SS */
	const char *dec_str = "+45*30:15";
	lx200_parse_result_t result = lx200_parse_dec_coordinate(dec_str, &coordinate);
	
	/* Currently returns error since not implemented */
	zassert_equal(result, LX200_PARSE_ERROR, "Function not implemented yet");
	
	/* TODO: When implemented, test should be:
	 * ASSERT_PARSE_OK(result);
	 * zassert_equal(coordinate.degrees, 45, "Degrees should be 45");
	 * zassert_equal(coordinate.minutes, 30, "Minutes should be 30");
	 * zassert_equal(coordinate.seconds, 15, "Seconds should be 15");
	 * zassert_false(coordinate.is_negative, "Should be positive");
	 */
}

ZTEST(lx200_coordinates, test_parse_dec_negative)
{
	/* Test negative declination: -DD*MM:SS */
	const char *dec_str = "-30*15:45";
	lx200_parse_result_t result = lx200_parse_dec_coordinate(dec_str, &coordinate);
	
	/* Currently returns error since not implemented */
	zassert_equal(result, LX200_PARSE_ERROR, "Function not implemented yet");
	
	/* TODO: When implemented, test should be:
	 * ASSERT_PARSE_OK(result);
	 * zassert_equal(coordinate.degrees, 30, "Degrees should be 30");
	 * zassert_equal(coordinate.minutes, 15, "Minutes should be 15");
	 * zassert_equal(coordinate.seconds, 45, "Seconds should be 45");
	 * zassert_true(coordinate.is_negative, "Should be negative");
	 */
}

ZTEST(lx200_coordinates, test_parse_dec_boundary_values)
{
	struct {
		const char *dec_str;
		const char *description;
	} test_cases[] = {
		{"+90*00:00", "Maximum positive declination"},
		{"-90*00:00", "Maximum negative declination"},
		{"+00*00:00", "Zero declination"},
		{"+45*00:00", "Mid-range positive"},
		{"-45*00:00", "Mid-range negative"},
	};
	
	for (size_t i = 0; i < ARRAY_SIZE(test_cases); i++) {
		lx200_parse_result_t result = lx200_parse_dec_coordinate(test_cases[i].dec_str, &coordinate);
		
		/* Currently all return error since not implemented */
		zassert_equal(result, LX200_PARSE_ERROR, "Function not implemented yet: %s", 
			      test_cases[i].description);
	}
}

/* ============================================================================
 * ALTITUDE/AZIMUTH COORDINATE PARSING TESTS
 * ============================================================================ */

ZTEST(lx200_coordinates, test_parse_altitude)
{
	/* Test altitude parsing: sDD*MM:SS */
	const char *alt_str = "+30*15:30";
	lx200_parse_result_t result = lx200_parse_alt_coordinate(alt_str, &coordinate);
	
	/* Currently returns error since not implemented */
	zassert_equal(result, LX200_PARSE_ERROR, "Function not implemented yet");
}

ZTEST(lx200_coordinates, test_parse_azimuth)
{
	/* Test azimuth parsing: DDD*MM:SS */
	const char *az_str = "180*30:15";
	lx200_parse_result_t result = lx200_parse_az_coordinate(az_str, &coordinate);
	
	/* Currently returns error since not implemented */
	zassert_equal(result, LX200_PARSE_ERROR, "Function not implemented yet");
}

/* ============================================================================
 * GEOGRAPHIC COORDINATE PARSING TESTS
 * ============================================================================ */

ZTEST(lx200_coordinates, test_parse_longitude)
{
	/* Test longitude parsing: sDDD*MM */
	const char *lon_str = "-122*30";
	lx200_parse_result_t result = lx200_parse_longitude(lon_str, &coordinate);
	
	/* Currently returns error since not implemented */
	zassert_equal(result, LX200_PARSE_ERROR, "Function not implemented yet");
}

ZTEST(lx200_coordinates, test_parse_latitude)
{
	/* Test latitude parsing: sDD*MM */
	const char *lat_str = "+37*45";
	lx200_parse_result_t result = lx200_parse_latitude(lat_str, &coordinate);
	
	/* Currently returns error since not implemented */
	zassert_equal(result, LX200_PARSE_ERROR, "Function not implemented yet");
}

/* ============================================================================
 * TIME AND DATE PARSING TESTS
 * ============================================================================ */

ZTEST(lx200_time_date, test_parse_time)
{
	/* Test time parsing: HH:MM:SS */
	const char *time_str = "14:30:45";
	lx200_parse_result_t result = lx200_parse_time(time_str, &time_val);
	
	/* Currently returns error since not implemented */
	zassert_equal(result, LX200_PARSE_ERROR, "Function not implemented yet");
	
	/* TODO: When implemented, test should be:
	 * ASSERT_PARSE_OK(result);
	 * zassert_equal(time_val.hours, 14, "Hours should be 14");
	 * zassert_equal(time_val.minutes, 30, "Minutes should be 30");
	 * zassert_equal(time_val.seconds, 45, "Seconds should be 45");
	 */
}

ZTEST(lx200_time_date, test_parse_date)
{
	/* Test date parsing: MM/DD/YY */
	const char *date_str = "12/25/23";
	lx200_parse_result_t result = lx200_parse_date(date_str, &date_val);
	
	/* Currently returns error since not implemented */
	zassert_equal(result, LX200_PARSE_ERROR, "Function not implemented yet");
	
	/* TODO: When implemented, test should be:
	 * ASSERT_PARSE_OK(result);
	 * zassert_equal(date_val.month, 12, "Month should be 12");
	 * zassert_equal(date_val.day, 25, "Day should be 25");
	 * zassert_equal(date_val.year, 23, "Year should be 23");
	 */
}

ZTEST(lx200_time_date, test_parse_utc_offset)
{
	/* Test UTC offset parsing: sHH or sHH.H */
	const char *offset_str = "-08";
	float offset = 0.0f;
	lx200_parse_result_t result = lx200_parse_utc_offset(offset_str, &offset);
	
	/* Currently returns error since not implemented */
	zassert_equal(result, LX200_PARSE_ERROR, "Function not implemented yet");
}

/* ============================================================================
 * TRACKING AND SLEW RATE PARSING TESTS
 * ============================================================================ */

ZTEST(lx200_rates, test_parse_tracking_rate)
{
	/* Test tracking rate parsing: TT.T */
	const char *rate_str = "60.1";
	float rate = 0.0f;
	lx200_parse_result_t result = lx200_parse_tracking_rate(rate_str, &rate);
	
	/* Currently returns error since not implemented */
	zassert_equal(result, LX200_PARSE_ERROR, "Function not implemented yet");
}

ZTEST(lx200_rates, test_parse_slew_rate)
{
	/* Test slew rate parsing */
	const char *rate_str = "RC";
	lx200_slew_rate_t rate = LX200_SLEW_GUIDE;
	lx200_parse_result_t result = lx200_parse_slew_rate(rate_str, &rate);
	
	/* Currently returns error since not implemented */
	zassert_equal(result, LX200_PARSE_ERROR, "Function not implemented yet");
}

/* ============================================================================
 * COORDINATE FORMATTING TESTS
 * ============================================================================ */

ZTEST(lx200_formatting, test_format_ra_coordinate)
{
	/* Test RA coordinate formatting */
	lx200_coordinate_t coord = {
		.degrees = 14,
		.minutes = 30,
		.seconds = 45,
		.is_negative = false,
		.precision = LX200_COORD_HIGH_PRECISION
	};
	
	char buffer[32];
	int result = lx200_format_ra_coordinate(&coord, buffer, sizeof(buffer));
	
	/* Currently returns error since not implemented */
	zassert_equal(result, -1, "Function not implemented yet");
}

ZTEST(lx200_formatting, test_format_dec_coordinate)
{
	/* Test Dec coordinate formatting */
	lx200_coordinate_t coord = {
		.degrees = 45,
		.minutes = 30,
		.seconds = 15,
		.is_negative = false,
		.precision = LX200_COORD_HIGH_PRECISION
	};
	
	char buffer[32];
	int result = lx200_format_dec_coordinate(&coord, buffer, sizeof(buffer));
	
	/* Currently returns error since not implemented */
	zassert_equal(result, -1, "Function not implemented yet");
}

ZTEST(lx200_formatting, test_format_time)
{
	/* Test time formatting */
	lx200_time_t time = {
		.hours = 14,
		.minutes = 30,
		.seconds = 45,
		.is_24h_format = true
	};
	
	char buffer[32];
	int result = lx200_format_time(&time, buffer, sizeof(buffer));
	
	/* Currently returns error since not implemented */
	zassert_equal(result, -1, "Function not implemented yet");
}

ZTEST(lx200_formatting, test_format_date)
{
	/* Test date formatting */
	lx200_date_t date = {
		.month = 12,
		.day = 25,
		.year = 23
	};
	
	char buffer[32];
	int result = lx200_format_date(&date, buffer, sizeof(buffer));
	
	/* Currently returns error since not implemented */
	zassert_equal(result, -1, "Function not implemented yet");
}

/* ============================================================================
 * VALIDATION TESTS
 * ============================================================================ */

ZTEST(lx200_validation, test_validate_coordinate)
{
	/* Test coordinate validation */
	lx200_coordinate_t coord = {
		.degrees = 45,
		.minutes = 30,
		.seconds = 15,
		.is_negative = false,
		.precision = LX200_COORD_HIGH_PRECISION
	};
	
	bool result = lx200_validate_coordinate(&coord, LX200_CMD_SET);
	
	/* Currently returns false since not implemented */
	zassert_false(result, "Function not implemented yet");
}

ZTEST(lx200_validation, test_validate_time)
{
	/* Test time validation */
	lx200_time_t time = {
		.hours = 14,
		.minutes = 30,
		.seconds = 45,
		.is_24h_format = true
	};
	
	bool result = lx200_validate_time(&time);
	
	/* Currently returns false since not implemented */
	zassert_false(result, "Function not implemented yet");
}

ZTEST(lx200_validation, test_validate_date)
{
	/* Test date validation */
	lx200_date_t date = {
		.month = 12,
		.day = 25,
		.year = 23
	};
	
	bool result = lx200_validate_date(&date);
	
	/* Currently returns false since not implemented */
	zassert_false(result, "Function not implemented yet");
}

/* ============================================================================
 * ERROR CASES FOR UNIMPLEMENTED FUNCTIONS
 * ============================================================================ */

ZTEST(lx200_coordinates_errors, test_null_parameter_handling)
{
	/* Test that unimplemented functions handle NULL parameters gracefully */
	
	zassert_equal(lx200_parse_ra_coordinate(NULL, &coordinate), LX200_PARSE_ERROR, 
		      "Should handle NULL string");
	zassert_equal(lx200_parse_ra_coordinate("14:30:45", NULL), LX200_PARSE_ERROR,
		      "Should handle NULL coordinate");
	
	zassert_equal(lx200_parse_dec_coordinate(NULL, &coordinate), LX200_PARSE_ERROR,
		      "Should handle NULL string");
	zassert_equal(lx200_parse_dec_coordinate("+45*30:15", NULL), LX200_PARSE_ERROR,
		      "Should handle NULL coordinate");
	
	zassert_equal(lx200_parse_time(NULL, &time_val), LX200_PARSE_ERROR,
		      "Should handle NULL string");
	zassert_equal(lx200_parse_time("14:30:45", NULL), LX200_PARSE_ERROR,
		      "Should handle NULL time");
	
	zassert_equal(lx200_parse_date(NULL, &date_val), LX200_PARSE_ERROR,
		      "Should handle NULL string");
	zassert_equal(lx200_parse_date("12/25/23", NULL), LX200_PARSE_ERROR,
		      "Should handle NULL date");
}

/* ============================================================================
 * TEST SUITE DEFINITIONS
 * ============================================================================ */

ZTEST_SUITE(lx200_coordinates, NULL, NULL, coordinate_test_setup, NULL, NULL);
ZTEST_SUITE(lx200_time_date, NULL, NULL, coordinate_test_setup, NULL, NULL);
ZTEST_SUITE(lx200_rates, NULL, NULL, NULL, NULL, NULL);
ZTEST_SUITE(lx200_formatting, NULL, NULL, NULL, NULL, NULL);
ZTEST_SUITE(lx200_validation, NULL, NULL, NULL, NULL, NULL);
ZTEST_SUITE(lx200_coordinates_errors, NULL, NULL, coordinate_test_setup, NULL, NULL);
```

## src/test_integration.cpp
```c
/*
 * LX200 Integration Tests - Result<T> API
 * End-to-end tests demonstrating Result<T> patterns and workflows
 */

#include <lx200/lx200.hpp>
#include <zephyr/ztest.h>

using namespace lx200;

/* ========================================================================
 * Parser + Coordinate Integration Tests
 * ======================================================================== */

ZTEST(lx200_integration, test_parse_set_ra_command)
{
	ParserState parser;

	// Parse command ":Sr12:34:56#"
	const char *cmd = ":Sr12:34:56#";
	for (const char *p = cmd; *p != '\0'; p++) {
		auto result = parser.feed_character(*p);
		if (result.is_error()) {
			zassert_unreachable("Parser should not error");
		}
	}

	zassert_true(parser.is_command_ready(), "Command should be ready");

	auto command_opt = parser.get_command();
	zassert_true(command_opt.has_value(), "Should have command");
	auto command = command_opt.value();

	zassert_equal(command.name[0], 'S', "Command family should be 'S'");
	zassert_equal(command.name[1], 'r', "Command should be 'r'");

	// Extract parameter
	std::string_view param = command.parameters;

	// Parse the coordinate
	auto coord_result = parse_ra(param, PrecisionMode::High);
	zassert_true(coord_result.is_ok(), "Should parse RA coordinate");

	auto coord = coord_result.value();
	zassert_equal(coord.hours, 12);
	zassert_equal(coord.minutes, 34);
	zassert_equal(coord.seconds, 56);
}

ZTEST(lx200_integration, test_parse_set_dec_command)
{
	ParserState parser;

	// Parse command ":Sd+45*30:15#"
	const char *cmd = ":Sd+45*30:15#";
	for (const char *p = cmd; *p != '\0'; p++) {
		auto result = parser.feed_character(*p);
		if (result.is_error()) {
			zassert_unreachable("Parser should not error");
		}
	}

	zassert_true(parser.is_command_ready(), "Command should be ready");

	auto command_opt = parser.get_command();
	zassert_true(command_opt.has_value());
	auto command = command_opt.value();
	zassert_equal(command.name[0], 'S', "Command family should be 'S'");
	zassert_equal(command.name[1], 'd', "Command should be 'd'");

	// Extract parameter
	std::string_view param = command.parameters;

	// Parse the coordinate
	auto coord_result = parse_dec(param, PrecisionMode::High);
	zassert_true(coord_result.is_ok(), "Should parse DEC coordinate");

	auto coord = coord_result.value();
	zassert_equal(coord.sign, '+');
	zassert_equal(coord.degrees, 45);
	zassert_equal(coord.arcminutes, 30);
	zassert_equal(coord.arcseconds, 15);
}

ZTEST(lx200_integration, test_parse_set_site_latitude)
{
	ParserState parser;

	// Parse command ":St+37*23#"
	const char *cmd = ":St+37*23#";
	for (const char *p = cmd; *p != '\0'; p++) {
		parser.feed_character(*p);
	}

	auto command_opt = parser.get_command();
	zassert_true(command_opt.has_value());
	auto command = command_opt.value();
	std::string_view param = command.parameters;

	auto coord_result = parse_latitude(param);
	zassert_true(coord_result.is_ok(), "Should parse latitude");

	auto coord = coord_result.value();
	zassert_equal(coord.sign, '+');
	zassert_equal(coord.degrees, 37);
	zassert_equal(coord.arcminutes, 23);
}

ZTEST(lx200_integration, test_parse_set_site_longitude)
{
	ParserState parser;

	// Parse command ":Sg122*04#" (longitude has no sign)
	const char *cmd = ":Sg122*04#";
	for (const char *p = cmd; *p != '\0'; p++) {
		parser.feed_character(*p);
	}

	auto command_opt = parser.get_command();
	zassert_true(command_opt.has_value());
	auto command = command_opt.value();
	std::string_view param = command.parameters;

	auto coord_result = parse_longitude(param);
	zassert_true(coord_result.is_ok(), "Should parse longitude");

	auto coord = coord_result.value();
	zassert_equal(coord.degrees, 122);
	zassert_equal(coord.arcminutes, 4);
}

ZTEST(lx200_integration, test_parse_set_local_time)
{
	ParserState parser;

	// Parse command ":SL14:30:45#"
	const char *cmd = ":SL14:30:45#";
	for (const char *p = cmd; *p != '\0'; p++) {
		parser.feed_character(*p);
	}

	auto command_opt = parser.get_command();
	zassert_true(command_opt.has_value());
	auto command = command_opt.value();
	std::string_view param = command.parameters;

	auto time_result = parse_time(param);
	zassert_true(time_result.is_ok(), "Should parse time");

	auto time = time_result.value();
	zassert_equal(time.hours, 14);
	zassert_equal(time.minutes, 30);
	zassert_equal(time.seconds, 45);
}

ZTEST(lx200_integration, test_parse_set_calendar_date)
{
	ParserState parser;

	// Parse command ":SC12/25/23#"
	const char *cmd = ":SC12/25/23#";
	for (const char *p = cmd; *p != '\0'; p++) {
		parser.feed_character(*p);
	}

	auto command_opt = parser.get_command();
	zassert_true(command_opt.has_value());
	auto command = command_opt.value();
	std::string_view param = command.parameters;

	auto date_result = parse_date(param);
	zassert_true(date_result.is_ok(), "Should parse date");

	auto date = date_result.value();
	zassert_equal(date.month, 12);
	zassert_equal(date.day, 25);
	zassert_equal(date.year, 23);
}

/* ========================================================================
 * Error Handling Integration Tests
 * ======================================================================== */

ZTEST(lx200_integration, test_parser_error_propagation)
{
	ParserState parser;

	// Try to parse invalid command (no start marker)
	auto result = parser.feed_character('G');

	zassert_true(result.is_error(), "Should error immediately");
	zassert_equal(result.error(), ParseError::InvalidFormat);

	// Parser should still be in error state
	zassert_false(parser.is_command_ready(), "No valid command");
}

ZTEST(lx200_integration, test_coordinate_error_in_command)
{
	ParserState parser;

	// Parse command with invalid RA ":Sr24:00:00#"
	const char *cmd = ":Sr24:00:00#";
	for (const char *p = cmd; *p != '\0'; p++) {
		parser.feed_character(*p);
	}

	auto command_opt = parser.get_command();
	zassert_true(command_opt.has_value());
	auto command = command_opt.value();
	std::string_view param = command.parameters;

	// Try to parse the invalid coordinate
	auto coord_result = parse_ra(param, PrecisionMode::High);

	zassert_true(coord_result.is_error(), "Should error on invalid RA");
	zassert_equal(coord_result.error(), ParseError::OutOfRange);
}

/* ========================================================================
 * Result<T> Pattern Demonstrations
 * ======================================================================== */

ZTEST(lx200_integration, test_result_chaining_with_match)
{
	auto ra_result = parse_ra("12:34:56", PrecisionMode::High);
	auto dec_result = parse_dec("+45*30:15", PrecisionMode::High);

	// Both should succeed
	bool both_ok = ra_result.is_ok() && dec_result.is_ok();
	zassert_true(both_ok, "Both coordinates should parse");

	// Use match to extract values
	RACoordinate ra{};
	ra_result.match([&ra](const RACoordinate &coord) { ra = coord; },
			[](ParseError) { zassert_unreachable("RA should not error"); });

	DECCoordinate dec{};
	dec_result.match([&dec](const DECCoordinate &coord) { dec = coord; },
			 [](ParseError) { zassert_unreachable("DEC should not error"); });

	// Verify extracted values
	zassert_equal(ra.hours, 12);
	zassert_equal(dec.degrees, 45);
}

ZTEST(lx200_integration, test_result_error_handling_with_match)
{
	auto result = parse_ra("invalid", PrecisionMode::High);

	bool error_handled = false;
	ParseError captured_error = ParseError::General;

	result.match([](const RACoordinate &) { zassert_unreachable("Should not succeed"); },
		     [&](ParseError err) {
			     error_handled = true;
			     captured_error = err;
		     });

	zassert_true(error_handled, "Error callback should be called");
	zassert_equal(captured_error, ParseError::InvalidFormat);
}

ZTEST(lx200_integration, test_result_value_or_with_fallback)
{
	// Invalid parse
	auto error_result = parse_time("99:99:99");

	// Provide fallback
	TimeValue fallback{12, 0, 0};
	auto time = error_result.value_or(fallback);

	zassert_equal(time.hours, 12, "Should use fallback hours");
	zassert_equal(time.minutes, 0, "Should use fallback minutes");
	zassert_equal(time.seconds, 0, "Should use fallback seconds");

	// Valid parse should not use fallback
	auto valid_result = parse_time("14:30:45");
	time = valid_result.value_or(fallback);

	zassert_equal(time.hours, 14, "Should use parsed hours");
	zassert_equal(time.minutes, 30, "Should use parsed minutes");
	zassert_equal(time.seconds, 45, "Should use parsed seconds");
}

ZTEST(lx200_integration, test_multiple_coordinate_validation)
{
	struct SiteLocation {
		LatitudeCoordinate lat;
		LongitudeCoordinate lon;
	};

	auto lat_result = parse_latitude("+37*23");
	auto lon_result = parse_longitude("122*04"); // Longitude has no sign

	if (lat_result.is_ok() && lon_result.is_ok()) {
		SiteLocation loc = {lat_result.value(), lon_result.value()};

		zassert_equal(loc.lat.degrees, 37);
		zassert_equal(loc.lon.degrees, 122);
	} else {
		zassert_unreachable("Both coordinates should parse");
	}
}

ZTEST(lx200_integration, test_precision_mode_switching)
{
	const char *ra_str = "12:34.5"; // Could be low or high precision format

	// Try high precision first (will fail for this format)
	auto high_result = parse_ra(ra_str, PrecisionMode::High);

	if (high_result.is_error()) {
		// Fall back to low precision
		auto low_result = parse_ra(ra_str, PrecisionMode::Low);

		if (low_result.is_ok()) {
			auto coord = low_result.value();
			zassert_equal(coord.hours, 12);
			zassert_equal(coord.minutes, 34);
			// Note: .5 tenths = 30 seconds
		}
	}
}

ZTEST(lx200_integration, test_void_result_from_parser)
{
	ParserState parser;

	// VoidResult indicates success/failure without a value
	VoidResult result = parser.feed_character(':');

	zassert_true(result.is_ok(), "Should succeed");

	// Can use match on VoidResult too
	bool success = false;
	result.match([&](const Unit &) { success = true; },
		     [](ParseError) { zassert_unreachable("Should not error"); });

	zassert_true(success, "Match should work on VoidResult");
}

/* ========================================================================
 * Real-World Command Scenarios
 * ======================================================================== */

ZTEST(lx200_integration, test_slew_to_target_workflow)
{
	ParserState parser;

	// Step 1: Set target RA
	const char *set_ra = ":Sr12:34:56#";
	for (const char *p = set_ra; *p != '\0'; p++) {
		parser.feed_character(*p);
	}

	auto ra_cmd_opt = parser.get_command();
	zassert_true(ra_cmd_opt.has_value());
	std::string_view ra_param = ra_cmd_opt->parameters;
	auto ra_result = parse_ra(ra_param, PrecisionMode::High);
	zassert_true(ra_result.is_ok(), "RA should parse");

	parser.reset();

	// Step 2: Set target DEC
	const char *set_dec = ":Sd+45*30:15#";
	for (const char *p = set_dec; *p != '\0'; p++) {
		parser.feed_character(*p);
	}

	auto dec_cmd_opt = parser.get_command();
	zassert_true(dec_cmd_opt.has_value());
	std::string_view dec_param = dec_cmd_opt->parameters;
	auto dec_result = parse_dec(dec_param, PrecisionMode::High);
	zassert_true(dec_result.is_ok(), "DEC should parse");

	// Both coordinates valid - ready to slew
	if (ra_result.is_ok() && dec_result.is_ok()) {
		auto ra = ra_result.value();
		auto dec = dec_result.value();

		// In real code, would initiate slew here
		zassert_equal(ra.hours, 12);
		zassert_equal(dec.degrees, 45);
	}
}

ZTEST(lx200_integration, test_site_setup_workflow)
{
	// Simulate setting up site location
	auto lat_result = parse_latitude("+37*23");
	auto lon_result =
		parse_longitude("122*04"); // Longitude has no sign (0-359 west from Greenwich)

	// Both must succeed for valid site
	if (!lat_result.is_ok() || !lon_result.is_ok()) {
		zassert_unreachable("Site coordinates should parse");
	}

	auto lat = lat_result.value();
	auto lon = lon_result.value();

	// Verify site is in Northern Hemisphere
	zassert_equal(lat.sign, '+', "Should be North");
	// Longitude is 0-359 degrees west from Greenwich (no sign)
	zassert_true(lon.degrees < 360, "Longitude should be valid");
}

ZTEST(lx200_integration, test_time_and_date_setup)
{
	// Set local time and date
	auto time_result = parse_time("14:30:45");
	auto date_result = parse_date("12/25/23");

	if (time_result.is_ok() && date_result.is_ok()) {
		auto time = time_result.value();
		auto date = date_result.value();

		// Verify time: 2:30:45 PM
		zassert_equal(time.hours, 14);
		zassert_equal(time.minutes, 30);

		// Verify date: December 25, 2023
		zassert_equal(date.month, 12);
		zassert_equal(date.day, 25);
		zassert_equal(date.year, 23);
	}
}

ZTEST_SUITE(lx200_integration, NULL, NULL, NULL, NULL, NULL);
```
