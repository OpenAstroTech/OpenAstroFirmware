## app/src/mount/Kconfig
```kconfig
menu "Mount"

config MOUNT_THREAD_STACK_SIZE
    hex "Mount stack size"
    default 0x4000
    help
        The size of the stack used by the mount thread.
        The default value is 0x4000 bytes (16kB).

module = MOUNT
module-str = mount
source "subsys/logging/Kconfig.template.log_config"

endmenu
```

## app/src/processor/lx200/Kconfig
```kconfig
menu "Lx200"

module = LX200
module-str = lx200
source "subsys/logging/Kconfig.template.log_config"

config LX200_STACK_SIZE
    hex "LX200 parser stack size"
    default 0x4000
    help
        The size of the stack used by the LX200 parser. This is
        a fixed size stack, so it should be large enough to
        accommodate the maximum depth of the parser.
        The default value is 0x4000 bytes (16kB).

config LX200_MESSAGE_BUFFER_SIZE
    hex "LX200 message buffer size"
    default 0x80
    help
        The size of the message buffer used to store currently
        received messages. This is a fixed size buffer, so it
        should be large enough to accommodate the maximum
        message size. The default value is 0x80 bytes (128
        bytes).

endmenu
```

## application/west.yml
```yaml
manifest:
  remotes:
    - name: zephyrproject
      url-base: https://github.com/andre-stefanov
  projects:
    - name: zephyr
      repo-path: zephyr
      remote: zephyrproject
      revision: stepper-velocity-float
      clone-depth: 1
      import:
        path-prefix: external
```

## boards/mks/robin_e3/Kconfig.robin_e3
```kconfig
# Copyright (c) 2021 Nordic Semiconductor ASA
# SPDX-License-Identifier: Apache-2.0

config BOARD_ROBIN_E3
	select SOC_STM32F103XE
```

## boards/mks/robin_nano/Kconfig.robin_nano
```kconfig
# Copyright (c) 2021 Nordic Semiconductor ASA
# SPDX-License-Identifier: Apache-2.0

config BOARD_ROBIN_NANO
	select SOC_STM32F407XG
```

## firmware/lib/lx200/Kconfig
```kconfig
menu "Meade LX200 Protocol Library"

module = LX200
module-str = Meade LX200
module-dep = RING_BUFFER
module-str = LX200

config LX200
    bool "Enable Meade LX200 protocol"
    default y
    select RING_BUFFER
    help
      Enable support for the LX200 protocol.

source "subsys/logging/Kconfig.template.log_config"

endmenu
```

## firmware/src/processor/lx200/Kconfig
```kconfig
menu "LX200"

module = LX200
module-str = lx200
source "subsys/logging/Kconfig.template.log_config"

endmenu
```

## lib/lx200/Kconfig
```kconfig
# Copyright (c) 2025, OpenAstroTech
# SPDX-License-Identifier: Apache-2.0

config LX200
	bool "Support for lx200 protocol"
	help
	  This option enables support for the lx200 protocol.

if LX200

module = LX200
module-str = lx200
source "subsys/logging/Kconfig.template.log_config"

endif # LX200
```

## tests/lib/lx200/testcase.yaml
```yaml
common:
  tags:
    - lx200
    - telescope
    - protocol
    - parser
    - cpp20
  timeout: 60
  integration_platforms:
    - robin_nano
    - native_sim
  platform_allow:
    - native_sim
    - qemu_x86
    - qemu_cortex_m3
    - robin_nano

tests:
  # C++20 LX200 Parser Tests
  lib.lx200.parser:
    tags:
      - parser
      - state_machine
    extra_configs:
      - CONFIG_LX200=y
      - CONFIG_LX200_LOG_LEVEL_DBG=y
  
  lib.lx200.coordinates:
    tags:
      - coordinates
      - parsing
    extra_configs:
      - CONFIG_LX200=y
  
  lib.lx200.commands:
    tags:
      - commands
      - command_families
    extra_configs:
      - CONFIG_LX200=y
  
  lib.lx200.integration:
    tags:
      - integration
      - end_to_end
    extra_configs:
      - CONFIG_LX200=y
    min_ram: 32
```

## tests/test-example/testcase.yaml
```yaml
tests:
  example.framework_tests:
    platform_allow: native_posix
    tags: example_tests
```
